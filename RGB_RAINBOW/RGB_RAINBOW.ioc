# file: RGB_RAINBOW.ioc
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Dma.Request0=TIM1_CH1
Dma.TIM1_CH1.0.Direction=DMA_MEMORY_TO_PERIPH
Dma.TIM1_CH1.0.Instance=DMA1_Channel2
Dma.TIM1_CH1.0.MemDataAlignment=DMA_MDATAALIGN_HALFWORD
Dma.TIM1_CH1.0.MemInc=DMA_MINC_ENABLE
Dma.TIM1_CH1.0.Mode=DMA_NORMAL
Dma.TIM1_CH1.0.PeriphDataAlignment=DMA_PDATAALIGN_HALFWORD
Dma.TIM1_CH1.0.PeriphInc=DMA_PINC_DISABLE
Dma.TIM1_CH1.0.Priority=DMA_PRIORITY_LOW
Mcu.Family=STM32F3
Mcu.Name=STM32F303V(B-C)Tx
Mcu.Package=LQFP100
NVIC.DMA1_Channel2_IRQn=true\:0\:0\:false\:false\:true\:false\:true\:true
NVIC.PriorityGroup=NVIC_PRIORITYGROUP_0
PE9.Signal=S_TIM1_CH1
PF0-OSC_IN.Mode=HSE-External-Clock-Source
PF0-OSC_IN.Signal=RCC_OSC_IN
ProjectManager.HeapSize=0x200
ProjectManager.StackSize=0x400
ProjectManager.TargetToolchain=STM32CubeIDE
RCC.AHBFreq_Value=72000000
RCC.APB1CLKDivider=RCC_HCLK_DIV2
RCC.APB1Freq_Value=36000000
RCC.APB1TimFreq_Value=72000000
RCC.APB2Freq_Value=72000000
RCC.APB2TimFreq_Value=72000000
RCC.CortexFreq_Value=72000000
RCC.HCLKFreq_Value=72000000
RCC.HSE_VALUE=8000000
RCC.HSI_VALUE=8000000
RCC.LSE_VALUE=32768
RCC.PLLMUL=RCC_PLL_MUL9
RCC.PLLSourceVirtual=RCC_PLLSOURCE_HSE
RCC.SYSCLKFreq_VALUE=72000000
RCC.SYSCLKSourceVirtual=RCC_SYSCLKSOURCE_PLLCLK
RCC.USBFreq_Value=72000000
SH.S_TIM1_CH1.0=TIM1_CH1,PWM Generation1 CH1
TIM1.Channel-PWM\ Generation1\ CH1=TIM_CHANNEL_1
TIM1.Period=90-1
VP_TIM1_VS_ClockSourceINT.Mode=Internal
board=STM32F3DISCOVERY

// file: Core/Src/main.c
/* USER CODE BEGIN Header */
/**
 **************************
 * @file           : main.c
 * @brief          : Main program body
 **************************
 * @attention
 *
 * Copyright (c) 2023 STMicroelectronics.
 * All rights reserved.
 *
 * This software is licensed under terms that can be found in the LICENSE file
 * in the root directory of this software component.
 * If no LICENSE file comes with this software, it is provided AS-IS.
 *
 **************************
 */
/* USER CODE END Header */
#include "main.h"

/* USER CODE BEGIN Includes */
#include "math.h"

/* USER CODE END Includes */

TIM_HandleTypeDef htim1;
DMA_HandleTypeDef hdma_tim1_ch1;

void SystemClock_Config(void);
static void MX_GPIO_Init(void);
static void MX_DMA_Init(void);
static void MX_TIM1_Init(void);

/* USER CODE BEGIN 0 */

#define MAX_LED 40
#define USE_BRIGHTNESS 1

uint8_t LED_Data[MAX_LED][4];
uint8_t LED_Mod[MAX_LED][4];
int datasentflag = 0;

void HAL_TIM_PWM_PulseFinishedCallback(TIM_HandleTypeDef *htim) {
	/* Prevent unused argument(s) compilation warning */
	UNUSED(htim);
	HAL_TIM_PWM_Stop_DMA(&htim1, TIM_CHANNEL_1);
	datasentflag = 1;
}

void Set_LED(int LEDnum, int Red, int Green, int Blue) {
	LED_Data[LEDnum][0] = LEDnum;
	LED_Data[LEDnum][1] = Green;
	LED_Data[LEDnum][2] = Red;
	LED_Data[LEDnum][3] = Blue;

}

#define PI 3.14159265

void Set_Brightness(int brightness) {
#if USE_BRIGHTNESS

	if (brightness > 45)
		brightness = 45;
	for (int i = 0; i < MAX_LED; i++) {
		LED_Mod[i][0] = LED_Data[i][0];
		for (int j = 1; j < 4; j++) {
			float angle = 90 - brightness;
			angle = angle * PI / 180;
			LED_Mod[i][j] = (LED_Data[i][j]) / (tan(angle));
		}
	}
#endif
}

uint16_t pwmData[(24 * MAX_LED) + 50];

void WS2812_Send(void) {
	uint32_t indx = 0;
	uint32_t color;

	for (int i = 0; i < MAX_LED; i++) {
		color =
				((LED_Mod[i][1] << 16) | (LED_Mod[i][2] << 8) | (LED_Mod[i][3]));

		for (int i = 23; i >= 0; i--) {
			if (color & (1 << i)) {
				pwmData[indx] = 60; // 2/3 of 90%
			} else
				pwmData[indx] = 30; // 1/3 of 90
			indx++;
		}
	}
	for (int i = 0; i < 50; i++) {
		pwmData[indx] = 0;
		indx++;
	}

	HAL_TIM_PWM_Start_DMA(&htim1, TIM_CHANNEL_1, (uint32_t*) pwmData, indx);
	while (!datasentflag) {
	};
	datasentflag = 0;
}
uint16_t effStep = 0;

uint8_t rainbow_effect_left() {
	// Strip ID: 0 - Effect: Rainbow - LEDS: 8
	// Steps: 13 - Delay: 54
	// Colors: 3 (255.0.0, 0.255.0, 0.0.255)
	// Options: rainbowlen=8, toLeft=true,
//  if(millis() - strip_0.effStart < 54 * (strip_0.effStep)) return 0x00;

	float factor1, factor2;
	uint16_t ind;
	for (uint16_t j = 0; j < 40; j++) {
		ind = effStep + j * 1.625;
		switch ((int) ((ind % 13) / 4.333333333333333)) {
		case 0:
			factor1 = 1.0
					- ((float) (ind % 13 - 0 * 4.333333333333333)
							/ 4.333333333333333);
			factor2 = (float) ((int) (ind - 0) % 13) / 4.333333333333333;
			/**** chnaged here ***/
			Set_LED(j, 255 * factor1 + 0 * factor2, 0 * factor1 + 255 * factor2,
					0 * factor1 + 0 * factor2);
			WS2812_Send();
			break;
		case 1:
			factor1 = 1.0
					- ((float) (ind % 13 - 1 * 4.333333333333333)
							/ 4.333333333333333);
			factor2 = (float) ((int) (ind - 4.333333333333333) % 13)
					/ 4.333333333333333;
			Set_LED(j, 0 * factor1 + 0 * factor2, 255 * factor1 + 0 * factor2,
					0 * factor1 + 255 * factor2);
			WS2812_Send();
			break;
		case 2:
			factor1 = 1.0
					- ((float) (ind % 13 - 2 * 4.333333333333333)
							/ 4.333333333333333);
			factor2 = (float) ((int) (ind - 8.666666666666666) % 13)
					/ 4.333333333333333;
			Set_LED(j, 0 * factor1 + 255 * factor2, 0 * factor1 + 0 * factor2,
					255 * factor1 + 0 * factor2);
			WS2812_Send();
			break;
		}
	}
	if (effStep >= 13) {
		effStep = 0;
		return 0x03;
	} else
		effStep++;
	return 0x01;
}

uint8_t rainbow_effect_right() {
	// Strip ID: 0 - Effect: Rainbow - LEDS: 8
	// Steps: 14 - Delay: 30
	// Colors: 3 (255.0.0, 0.255.0, 0.0.255)
	// Options: rainbowlen=8, toLeft=false,
//  if(millis() - strip_0.effStart < 30 * (strip_0.effStep)) return 0x00;
	float factor1, factor2;
	uint16_t ind;
	for (uint16_t j = 0; j < 40; j++) {
		ind = 14 - (int16_t) (effStep - j * 1.75) % 14;
		switch ((int) ((ind % 14) / 4.666666666666667)) {
		case 0:
			factor1 = 1.0
					- ((float) (ind % 14 - 0 * 4.666666666666667)
							/ 4.666666666666667);
			factor2 = (float) ((int) (ind - 0) % 14) / 4.666666666666667;
			Set_LED(j, 255 * factor1 + 0 * factor2, 0 * factor1 + 255 * factor2,
					0 * factor1 + 0 * factor2);
			WS2812_Send();
			break;
		case 1:
			factor1 = 1.0
					- ((float) (ind % 14 - 1 * 4.666666666666667)
							/ 4.666666666666667);
			factor2 = (float) ((int) (ind - 4.666666666666667) % 14)
					/ 4.666666666666667;
			Set_LED(j, 0 * factor1 + 0 * factor2, 255 * factor1 + 0 * factor2,
					0 * factor1 + 255 * factor2);
			WS2812_Send();
			break;
		case 2:
			factor1 = 1.0
					- ((float) (ind % 14 - 2 * 4.666666666666667)
							/ 4.666666666666667);
			factor2 = (float) ((int) (ind - 9.333333333333334) % 14)
					/ 4.666666666666667;
			Set_LED(j, 0 * factor1 + 255 * factor2, 0 * factor1 + 0 * factor2,
					255 * factor1 + 0 * factor2);
			WS2812_Send();
			break;
		}
	}
	if (effStep >= 14) {
		effStep = 0;
		return 0x03;
	} else
		effStep++;
	return 0x01;
}

//uint16_t effStep=0;
//uint8_t rainbow_effect_right() {
//    // Strip ID: 0 - Effect: Rainbow - LEDS: 7
//    // Steps: 26 - Delay: 53
//    // Colors: 3 (255.0.0, 0.255.0, 0.0.255)
//    // Options: rainbowlen=8, toLeft=false,
////  if(millis() - strip_0.effStart < 53 * (strip_0.effStep)) return 0x00;
//  float factor1, factor2;
//  uint16_t ind;
//  for(uint16_t j=0;j<7;j++) {
//    ind = 26 - (int16_t)(effStep - j * 3.25) % 26;
//    switch((int)((ind % 26) / 8.666666666666666)) {
//      case 0: factor1 = 1.0 - ((float)(ind % 26 - 0 * 8.666666666666666) / 8.666666666666666);
//              factor2 = (float)((int)(ind - 0) % 26) / 8.666666666666666;
//           Set_LED(j, 255 * factor1 + 0 * factor2, 0 * factor1 + 255 * factor2, 0 * factor1 + 0 * factor2);
//           WS2812_Send();
//              break;
//      case 1: factor1 = 1.0 - ((float)(ind % 26 - 1 * 8.666666666666666) / 8.666666666666666);
//              factor2 = (float)((int)(ind - 8.666666666666666) % 26) / 8.666666666666666;
//              Set_LED (j, 0 * factor1 + 0 * factor2, 255 * factor1 + 0 * factor2, 0 * factor1 + 255 * factor2);
//              WS2812_Send();
//              break;
//      case 2: factor1 = 1.0 - ((float)(ind % 26 - 2 * 8.666666666666666) / 8.666666666666666);
//              factor2 = (float)((int)(ind - 17.333333333333332) % 26) / 8.666666666666666;
//              Set_LED(j, 0 * factor1 + 255 * factor2, 0 * factor1 + 0 * factor2, 255 * factor1 + 0 * factor2);
//              WS2812_Send();
//              break;
//    }
//  }
//  if(effStep >= 26) {effStep=0; return 0x03; }
//  else effStep++;
//  return 0x01;
//}

//void send(int Green, int Red, int Blue) {
//	uint32_t data = (Green << 16) | (Red << 8) | Blue;
//
//	for (int i = 23; i >= 0; i++) {
//		if (data & (1 << i))
//			pwmData[i] = 60;
//
//		else
//			pwmData[i] = 30;
//
//	}
//	HAL_TIM_PWM_Start_DMA(&htim1, TIM_CHANNEL_1, (uint32_t*) pwmData, 24);
//}

/* USER CODE END 0 */

int main(void) {

	/* MCU Configuration--------------------------------------------------------*/

	/* Reset of all peripherals, Initializes the Flash interface and the Systick. */
	HAL_Init();

	/* Configure the system clock */
	SystemClock_Config();

	/* Initialize all configured peripherals */
	MX_GPIO_Init();
	MX_DMA_Init();
	MX_TIM1_Init();
	/* USER CODE BEGIN 2 */
//for(int i=0;i<7:i++)

		for (int i = 0; i < 40; i++) {
			Set_LED(i, 255, 0, 0);
		}
//	    Set_LED(0, 148, 0, 211);
//
//
//	    Set_LED(1, 75,0,130);
//
//	    Set_LED(2, 0, 0, 255);
//	    Set_LED(3, 0, 255, 0);
//	    Set_LED(4, 255, 255, 0);
//	    Set_LED(5, 255, 127, 0);
//	    Set_LED(6, 255, 0, 0 );
//
//
//Set_Brightness(45);
//WS2812_Send();

	/* USER CODE END 2 */

	/* Infinite loop */
	while (1) {
		rainbow_effect_right();
		HAL_Delay(30);
		Set_Brightness(45);
		WS2812_Send();
//
//
//		for (int i = 0; i < 46; i++) {
//			Set_Brightness(i);
//		WS2812_Send();
//	HAL_Delay(50);
//	}
//
//		for (int i = 45; i >= 0; i--) {
//			Set_Brightness(i);
//			WS2812_Send();
//			HAL_Delay(50);
	}
}

void SystemClock_Config(void) {
	RCC_OscInitTypeDef RCC_OscInitStruct = { 0 };
	RCC_ClkInitTypeDef RCC_ClkInitStruct = { 0 };
	RCC_PeriphCLKInitTypeDef PeriphClkInit = { 0 };

	/** Initializes the RCC Oscillators according to the specified parameters
	 * in the RCC_OscInitTypeDef structure.
	 */
	RCC_OscInitStruct.OscillatorType = RCC_OSCILLATORTYPE_HSE;
	RCC_OscInitStruct.HSEState = RCC_HSE_BYPASS;
	RCC_OscInitStruct.HSEPredivValue = RCC_HSE_PREDIV_DIV1;
	RCC_OscInitStruct.HSIState = RCC_HSI_ON;
	RCC_OscInitStruct.PLL.PLLState = RCC_PLL_ON;
	RCC_OscInitStruct.PLL.PLLSource = RCC_PLLSOURCE_HSE;
	RCC_OscInitStruct.PLL.PLLMUL = RCC_PLL_MUL9;
	if (HAL_RCC_OscConfig(&RCC_OscInitStruct) != HAL_OK) {
		Error_Handler();
	}

	/** Initializes the CPU, AHB and APB buses clocks
	 */
	RCC_ClkInitStruct.ClockType = RCC_CLOCKTYPE_HCLK | RCC_CLOCKTYPE_SYSCLK
			| RCC_CLOCKTYPE_PCLK1 | RCC_CLOCKTYPE_PCLK2;
	RCC_ClkInitStruct.SYSCLKSource = RCC_SYSCLKSOURCE_PLLCLK;
	RCC_ClkInitStruct.AHBCLKDivider = RCC_SYSCLK_DIV1;
	RCC_ClkInitStruct.APB1CLKDivider = RCC_HCLK_DIV2;
	RCC_ClkInitStruct.APB2CLKDivider = RCC_HCLK_DIV1;

	if (HAL_RCC_ClockConfig(&RCC_ClkInitStruct, FLASH_LATENCY_2) != HAL_OK) {
		Error_Handler();
	}
	PeriphClkInit.PeriphClockSelection = RCC_PERIPHCLK_TIM1;
	PeriphClkInit.Tim1ClockSelection = RCC_TIM1CLK_HCLK;
	if (HAL_RCCEx_PeriphCLKConfig(&PeriphClkInit) != HAL_OK) {
		Error_Handler();
	}
}

static void MX_TIM1_Init(void) {

	TIM_ClockConfigTypeDef sClockSourceConfig = { 0 };
	TIM_MasterConfigTypeDef sMasterConfig = { 0 };
	TIM_OC_InitTypeDef sConfigOC = { 0 };
	TIM_BreakDeadTimeConfigTypeDef sBreakDeadTimeConfig = { 0 };

	htim1.Instance = TIM1;
	htim1.Init.Prescaler = 0;
	htim1.Init.CounterMode = TIM_COUNTERMODE_UP;
	htim1.Init.Period = 90 - 1;
	htim1.Init.ClockDivision = TIM_CLOCKDIVISION_DIV1;
	htim1.Init.RepetitionCounter = 0;
	htim1.Init.AutoReloadPreload = TIM_AUTORELOAD_PRELOAD_DISABLE;
	if (HAL_TIM_Base_Init(&htim1) != HAL_OK) {
		Error_Handler();
	}
	sClockSourceConfig.ClockSource = TIM_CLOCKSOURCE_INTERNAL;
	if (HAL_TIM_ConfigClockSource(&htim1, &sClockSourceConfig) != HAL_OK) {
		Error_Handler();
	}
	if (HAL_TIM_PWM_Init(&htim1) != HAL_OK) {
		Error_Handler();
	}
	sMasterConfig.MasterOutputTrigger = TIM_TRGO_RESET;
	sMasterConfig.MasterOutputTrigger2 = TIM_TRGO2_RESET;
	sMasterConfig.MasterSlaveMode = TIM_MASTERSLAVEMODE_DISABLE;
	if (HAL_TIMEx_MasterConfigSynchronization(&htim1, &sMasterConfig)
			!= HAL_OK) {
		Error_Handler();
	}
	sConfigOC.OCMode = TIM_OCMODE_PWM1;
	sConfigOC.Pulse = 0;
	sConfigOC.OCPolarity = TIM_OCPOLARITY_HIGH;
	sConfigOC.OCNPolarity = TIM_OCNPOLARITY_HIGH;
	sConfigOC.OCFastMode = TIM_OCFAST_DISABLE;
	sConfigOC.OCIdleState = TIM_OCIDLESTATE_RESET;
	sConfigOC.OCNIdleState = TIM_OCNIDLESTATE_RESET;
	if (HAL_TIM_PWM_ConfigChannel(&htim1, &sConfigOC, TIM_CHANNEL_1)
			!= HAL_OK) {
		Error_Handler();
	}
	sBreakDeadTimeConfig.OffStateRunMode = TIM_OSSR_DISABLE;
	sBreakDeadTimeConfig.OffStateIDLEMode = TIM_OSSI_DISABLE;
	sBreakDeadTimeConfig.LockLevel = TIM_LOCKLEVEL_OFF;
	sBreakDeadTimeConfig.DeadTime = 0;
	sBreakDeadTimeConfig.BreakState = TIM_BREAK_DISABLE;
	sBreakDeadTimeConfig.BreakPolarity = TIM_BREAKPOLARITY_HIGH;
	sBreakDeadTimeConfig.BreakFilter = 0;
	sBreakDeadTimeConfig.Break2State = TIM_BREAK2_DISABLE;
	sBreakDeadTimeConfig.Break2Polarity = TIM_BREAK2POLARITY_HIGH;
	sBreakDeadTimeConfig.Break2Filter = 0;
	sBreakDeadTimeConfig.AutomaticOutput = TIM_AUTOMATICOUTPUT_DISABLE;
	if (HAL_TIMEx_ConfigBreakDeadTime(&htim1, &sBreakDeadTimeConfig)
			!= HAL_OK) {
		Error_Handler();
	}
	HAL_TIM_MspPostInit(&htim1);

}

static void MX_DMA_Init(void) {

	/* DMA controller clock enable */
	__HAL_RCC_DMA1_CLK_ENABLE();

	/* DMA interrupt init */
	/* DMA1_Channel2_IRQn interrupt configuration */
	HAL_NVIC_SetPriority(DMA1_Channel2_IRQn, 0, 0);
	HAL_NVIC_EnableIRQ(DMA1_Channel2_IRQn);

}

static void MX_GPIO_Init(void) {

	/* GPIO Ports Clock Enable */
	__HAL_RCC_GPIOF_CLK_ENABLE();
	__HAL_RCC_GPIOE_CLK_ENABLE();

}

void Error_Handler(void) {
	__disable_irq();
	while (1) {
	}
}
